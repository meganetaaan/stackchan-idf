## sdkconfig.defaults.article04
```kconfig
CONFIG_STACKCHAN_CONVERSATION_ENABLED=y
CONFIG_STACKCHAN_AUDIO_STREAM_ENABLED=n
CONFIG_STACKCHAN_WIFI_AUDIO_ENABLED=n
CONFIG_STACKCHAN_CONVERSATION_DANCE=y
CONFIG_STACKCHAN_ASR_ENABLED=n
```
